/ {
    leds: leds {
        compatible = "gpio-leds";

        ext_leds: led_ext {
            gpios = <&gpio0 4 GPIO_ACTIVE_HIGH>,<&gpio0 6 GPIO_ACTIVE_HIGH>,<&gpio0 7 GPIO_ACTIVE_HIGH>;
            label = "External LEDs";
        };
    };
};

/ {
    aliases {
        user-leds = &ext_leds;
    };
};