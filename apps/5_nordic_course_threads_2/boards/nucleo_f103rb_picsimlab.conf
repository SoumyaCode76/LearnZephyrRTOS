## apps/5_nordic_course_threads_2/boards/nucleo_f103rb_picsimlab.conf
```kconfig
CONFIG_SERIAL=y
CONFIG_UART_CONSOLE=y
CONFIG_GPIO=y
CONFIG_CONSOLE=y
CONFIG_LOG=y
CONFIG_LOG_MODE_MINIMAL=y
CONFIG_TIMESLICING=y
CONFIG_TIMESLICE_SIZE=50
CONFIG_TIMESLICE_PRIORITY=0
```
