/ {
    leds: leds {
        compatible = "gpio-leds";

        ext_leds: led_ext {
            gpios = <&gpioa 4 GPIO_ACTIVE_HIGH>,<&gpioa 6 GPIO_ACTIVE_HIGH>,<&gpioa 7 GPIO_ACTIVE_HIGH>;
            label = "External LEDs";
        };
    };
};

/ {
    aliases {
        user-leds = &ext_leds;
    };
};